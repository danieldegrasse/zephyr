/*
 * Copyright 2022 Daniel DeGrasse
 *
 * SPDX-License-Identifier: Apache-2.0
 */

#include <nxp/nxp_k2x.dtsi>

/ {
	soc {
		i2c2: i2c@400e6000 {
			compatible = "nxp,kinetis-i2c";
			clock-frequency = <I2C_BITRATE_STANDARD>;
			#address-cells = <1>;
			#size-cells = <0>;
			reg = <0x400e6000 0x1000>;
			interrupts = <74 0>;
			clocks = <&sim KINETIS_SIM_BUS_CLK 0x1028 6>;
			status = "disabled";
		};
	};
};

/* Flash controller sector size is 4096 bytes */
&flash0 {
	erase-block-size = <4096>;
};
