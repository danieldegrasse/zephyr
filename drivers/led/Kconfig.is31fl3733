## drivers/led/Kconfig.is31fl3733
```kconfig
# Copyright 2022 Daniel DeGrasse <daniel@degrasse.com>
# SPDX-License-Identifier: Apache-2.0

config IS31FL3733
	bool "IS31FL3733 LED driver"
	default y
	depends on DT_HAS_ISSI_IS31FL3733_ENABLED
	select I2C
	help
	  Enable LED driver for IS31FL3733.
	  IS31FL3733 is a matrix LED driver, capable of a maximum of 3.29 mA
	  per LED, or 42 mA total across all LEDs in the 12x16 dot matrix.

if IS31FL3733

config IS31FL3733_BLINK_API
	bool "Enable led_blink API for IS31FL3733 driver"
	default y
	depends on !MINIMAL_LIBC
	help
	  Enable led_blink API for IS31FL3733 driver. Since the IS1FL3733 uses
	  discrete time options for auto breathe mode, this API requires use
	  of log2() and other LIBC functions to calculate the best possible
	  configuration for a given delay period requested via the API.

endif # IS31FL3733
```

## drivers/sensor/tcn75a/Kconfig
```kconfig
# Copyright 2022 Daniel DeGrasse <daniel@degrasse.com>
# SPDX-License-Identifier: Apache-2.0

config TCN75A
	bool "TCN75A Ambient Temperature Sensor"
	default y
	depends on DT_HAS_MICROCHIP_TCN75A_ENABLED
	select I2C
	help
	  Enable TCN75A ambient temperature to digital converter

if TCN75A

choice TCN75A_RESOLUTION
	prompt "TCN75A temperature resolution"
	default TCN75A_RESOLUTION_9BIT

# Note: datasheet's claim about the ambient temperature register:
# > When the 0.5°C, 0.25°C or 0.125°C resolutions are selected,
# > bit 6, bit 7 or bit 8 will remain clear <0>,
# > respectively.
# appears to be incorrect. Only conversion times seem to be affected by
# resolution selection.

config TCN75A_RESOLUTION_9BIT
	bool "9 bit resolution: 0.5C, 30ms conversion time"

config TCN75A_RESOLUTION_10BIT
	bool "10 bit resolution: 0.25C, 60ms conversion time"

config TCN75A_RESOLUTION_11BIT
	bool "11 bit resolution: 0.125C, 120ms conversion time"

config TCN75A_RESOLUTION_12BIT
	bool "12 bit resolution: 0.0625C, 240ms conversion time"

endchoice

choice TCN75A_OP_MODE
	prompt "TCN75A operation mode"
	default TCN75A_OP_MODE_CONTINUOUS

config TCN75A_OP_MODE_ONESHOT
	depends on TCN75A_RESOLUTION_9BIT
	bool "Oneshot sample mode"
	help
	  One shot sample mode. Offers lower power consumption than continuous
	  sampling, as sensor transitions to shutdown after taking a sample.
	  Does not support high resolution modes.

config TCN75A_OP_MODE_CONTINUOUS
	bool "Continuous sample mode"
	help
	  Read samples continuously. Required to use TCN75A trigger support

endchoice

choice
	prompt "TCN75A Trigger mode"
	default TCN75A_TRIGGER_NONE

config TCN75A_TRIGGER_NONE
	bool "No trigger"

config TCN75A_TRIGGER_OWN_THREAD
	bool "Use own thread"
	select TCN75A_TRIGGER

config TCN75A_TRIGGER_GLOBAL_THREAD
	bool "Use global thread"
	select TCN75A_TRIGGER

endchoice

config TCN75A_TRIGGER
	bool
	depends on TCN75A_OP_MODE_CONTINUOUS
	help
	  Enable interrupt based trigger support for TCN75A

if TCN75A_TRIGGER_OWN_THREAD

config TCN75A_THREAD_PRIORITY
	int "Own thread priority"
	depends on TCN75A_TRIGGER_OWN_THREAD
	default 10

config TCN75A_THREAD_STACK_SIZE
	int "Own thread stack size"
	depends on TCN75A_TRIGGER_OWN_THREAD
	default 1024

endif # TCN75A_TRIGGER_OWN_THREAD


endif # TCN75A
```

## dts/bindings/led/issi,is31fl3733.yaml
```yaml
# Copyright 2022 Daniel DeGrasse <daniel@degrasse.com>
# SPDX-License-Identifier: Apache-2.0
description: ISSI IS31FL3733 LED Matrix Driver

compatible: "issi,is31fl3733"

include: ["i2c-device.yaml", "led-controller.yaml"]


properties:
  sdb-gpios:
    type: phandle-array
    description: |
      Hardware shutdown pin. If routed on the board, this property must be
      present. Set to a logical 1 at boot to exit the device from hardware
      shutdown.
  current-limit:
    type: int
    default: 0xFF
    description: |
      Global current limit. Sets the global current control register of LED
      driver (set table 14). Limits global current based on the following
      formula: (840/R_ISET) * (current-limit/256). Defaults to max value
      of 0xFF, so led output will still be enabled if property is
      not provided.
  default-brightness:
    type: int
    default: 0xFF
    description: |
      This property allows the user to set LED brightness at boot, so
      that when an LED is enabled by the user it will have a preset
      brightness. If this setting is set to 0, LEDs will need to have
      a defined brightness set via the led_set_brightness API before
      they will illuminate. Defaults to maximum brightness of 0xFF.
  sync-mode:
    type: string
    default: "high-z"
    enum:
      - "high-z"
      - "master"
      - "slave"
    description: |
      This property configures the LED controller as a master or slave
      clock device. This can be used to synchronize the output of multiple
      LED controllers. See SYNC bits in led configuration register for more
      information.
```

## dts/bindings/sensor/microchip,tcn75a.yaml
```yaml
# Copyright 2022 Daniel DeGrasse <daniel@degrasse.com>
# SPDX-License-Identifier: Apache-2.0

description: TCN75A ambient temperature sensor

compatible: "microchip,tcn75a"

include: i2c-device.yaml

properties:
  alert-gpios:
    type: phandle-array
    description: |
      ALERT pin
      This pin defaults to active low when produced by the sensor.
      The property value should ensure the gpio flags properly describe
      the signal that is presented to the driver.
```

## soc/arm/nxp_kinetis/k2x/Kconfig.defconfig.mk22fa12
```kconfig
# Copyright 2022 Daniel DeGrasse
# SPDX-License-Identifier: Apache-2.0

# Kinetis MK22FA12 configuration options

if SOC_MK22F12

config SOC
	default "mk22f12"

config NUM_IRQS
	default 81

endif # SOC_MK22F12
```
