## drivers/mbox/Kconfig.mhuv2
```kconfig
# Copyright (c) 2026, Xsight Labs
# Copyright (c) 2026, Analog Devices Inc.
# SPDX-License-Identifier: Apache-2.0

config MBOX_MHUV2
	bool "ARM MHUv2 mailbox driver"
	depends on DT_HAS_ARM_MHUV2_ENABLED
	default y
	help
	  Driver for Arm MHUv2 (Message Handling Unit v2).
	  Provides doorbell or single-word signalling via the Zephyr mbox API.

if MBOX_MHUV2

config MBOX_MHUV2_NUM_CHANS
	int "ARM MHUv2 mailbox number of channels"
	range 1 124
	default 1
	help
	  Maximum number of hardware channel windows supported.
	  Must be less than or equal to MSG_NO_CAP reported by hardware.
	  MHUv2 allows up to 124 channel windows, each with 32 doorbell slots.
	  This configuration parameter is needed to avoid dynamic memory
	  allocation of per-doorbell data structures.

choice MBOX_MHUV2_PROTO
	prompt "MHUv2 transport protocol"
	default MBOX_MHUV2_PROTO_DOORBELL

config MBOX_MHUV2_PROTO_DOORBELL
	bool "Doorbell"
	help
	  Use doorbell signaling for MHUv2 transport protocol. This protocol
	  does not support data transfer, but can signal across up to 124
	  channels

config MBOX_MHUV2_PROTO_SINGLE_WORD
	bool "Single-word"
	help
	  Use single-word signaling for MHUv2 transport protocol. This protocol
	  supports data transfer using a single word and can signal across up to 4
	  channels.


endchoice

endif
```

## drivers/regulator/Kconfig.alif_phy
```kconfig
# Copyright (c) 2026 Analog Devices, Inc.
# SPDX-License-Identifier: Apache-2.0

config REGULATOR_ALIF_PHY
	bool "Alif Ensemble PHY power regulator driver"
	default y
	depends on DT_HAS_ALIF_ENSEMBLE_PHY_REGULATOR_ENABLED
	select ALIF_SE_SERVICE
	help
	  Enable the driver for Alif Ensemble PHY power domains. Each
	  regulator controls one bit of the phy_pwr_gating field of the
	  run profile through the Secure Enclave service.

config REGULATOR_ALIF_PHY_INIT_PRIORITY
	int "Alif Ensemble PHY power regulator init priority"
	default 46
	depends on REGULATOR_ALIF_PHY
	help
	  Init priority for the Alif Ensemble PHY power regulator driver.
	  It must be greater than ALIF_SE_SERVICE_INIT_PRIORITY.
```

## dts/bindings/regulator/alif,ensemble-phy-regulator.yaml
```yaml
# Copyright (c) 2026 Analog Devices, Inc.
# SPDX-License-Identifier: Apache-2.0

title: Alif Ensemble PHY power regulator

description: |
  Power switch for an Alif Ensemble PHY power domain. The regulator is
  enabled and disabled via the Secture enclave service, by
  setting and clearing the matching bit of the phy_pwr_gating field in
  the SOC's run profile.

compatible: "alif,ensemble-phy-regulator"

include:
  - name: base.yaml
  - name: regulator.yaml
    property-allowlist:
      - regulator-name
      - regulator-boot-on
      - regulator-boot-off

properties:
  phy:
    type: string
    required: true
    enum:
      - "ldo-phy"
      - "usb-phy"
      - "mipi-tx-dphy"
      - "mipi-rx-dphy"
      - "mipi-pll-dphy"
    description: |
      PHY power domain controlled by this regulator

examples:
  - |
    regulator-usb-phy {
      compatible = "alif,ensemble-phy-regulator";
      phy = "usb-phy";
    };
```

## soc/alif/ensemble/se_service/Kconfig
```kconfig
# Copyright (c) 2026 Analog Devices, Inc
# SPDX-License-Identifier: Apache-2.0

config ALIF_SE_SERVICE
	bool "ALIF Secure Enclave Service"
	default y
	select MBOX
	help
	  Enable the ALIF Secure Enclave Service, which manages SE power
	  profiles, and provides runtime APIs to interface with the SE.

if ALIF_SE_SERVICE

config ALIF_SE_SERVICE_INIT_PRIORITY
	int "SE service power profiles init priority"
	default 45
	help
	  SE service power profiles initialization priority. Runs in
	  PRE_KERNEL_1 context.


# SE uses single-word MHUv2 protocol
choice MBOX_MHUV2_PROTO
	default MBOX_MHUV2_PROTO_SINGLE_WORD
endchoice

module = ALIF_SE
module-str = "alif secure enclave service"
source "subsys/logging/Kconfig.template.log_config"

endif # ALIF_SE_SERVICE
```
