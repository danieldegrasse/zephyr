## dts/bindings/clock-management/nxp-kinetis/nxp,kinetis-mcg-mux.yaml
```yaml
# Copyright 2026 Analog Devices, Inc.
# SPDX-License-Identifier: Apache-2.0

description: |
  Kinetis MCG multiplexer. Accepts one specifier, which sets the multiplexer
  selection to the given zero based index in the "input-sources" phandle
  array for the given node.

  MCG selections take effect asynchronously, so the driver waits for the
  corresponding MCG_S status field after each change. The "mux-type"
  property selects this behavior:
    - "ircs":   C2[IRCS]. Waits for S[IRCST] while the IRC is enabled.
    - "irefs":  C1[IREFS]. Waits for S[OSCINIT0] when selecting a crystal
                external reference, then for S[IREFST], then for the FLL to
                reacquire lock.
    - "plls":   C6[PLLS]. Waits for S[PLLST], then for S[LOCK0] when
                selecting the PLL, or for the FLL to reacquire lock when
                selecting the FLL.
    - "oscsel": C7[OSCSEL]. Changes are rejected while the external
                reference clocks the MCG (FEE, FBE, PBE, PEE, BLPE, or while
                the PLL is enabled).

compatible: "nxp,kinetis-mcg-mux"

include: [clock-node.yaml]

properties:
  reg:
    required: true
    description: |
      Tuple containing address of the 8-bit MCG register and width of the
      bitfield to set to set the multiplexer selection.

  offset:
    type: int
    required: true
    description: |
      Offset of bitfield within register to set to configure multiplexer.

  mux-type:
    type: string
    required: true
    enum:
      - "ircs"
      - "irefs"
      - "plls"
      - "oscsel"
    description: |
      MCG selection this multiplexer controls.

  input-sources:
    type: phandles
    required: true
    description: |
      List of all input sources provided to the multiplexer. These sources
      should be references to other clock nodes within the clock tree.

  "#clock-cells":
    const: 1

clock-cells:
  - mux
```

## dts/bindings/clock-management/nxp-kinetis/nxp,kinetis-mcg-pll.yaml
```yaml
# Copyright 2026 Analog Devices, Inc.
# SPDX-License-Identifier: Apache-2.0

description: |
  Kinetis MCG phase locked loop (PLL), configured by MCG_C5[PRDIV0,
  PLLCLKEN0] and MCG_C6[VDIV0]. Output rate is (input / prdiv) * vdiv.

  Accepts three specifiers:
    - prdiv: PLL reference divider, from 1 to 25. The divided reference
      must be within 2-4 MHz whenever the PLL runs.
    - vdiv: VCO multiplier, from 24 to 55.
    - enable: set to 1 to set C5[PLLCLKEN0], enabling MCGPLLCLK
      independently of C6[PLLS].

  The PLL also runs while C6[PLLS] selects it. It is disabled in BLPI/BLPE
  mode, and reports a rate of 0 when not running. The dividers are only
  changed once the PLL is locked, and can't be changed while the PLL
  clocks MCGOUTCLK (PEE mode).

compatible: "nxp,kinetis-mcg-pll"

include: [clock-node.yaml]

properties:
  reg:
    required: true
    description: |
      Address and size of the MCG_C5 and MCG_C6 registers.

  input:
    type: phandle
    required: true
    description: |
      phandle to the MCG external reference select (OSCSEL).

  "#clock-cells":
    const: 3

clock-cells:
  - prdiv
  - vdiv
  - enable
```

## dts/bindings/clock-management/nxp-kinetis/nxp,kinetis-osc.yaml
```yaml
# Copyright 2026 Analog Devices, Inc.
# SPDX-License-Identifier: Apache-2.0

description: |
  Kinetis system oscillator (OSC). The oscillator has no enable bit- it runs
  whenever OSCERCLK is enabled or the MCG requests the external reference.

  The oscillator range, gain and input mode are fixed by board hardware, so
  they are described with properties rather than specifiers. MCG_C2[RANGE] is
  derived from the "frequency" property, and MCG_C2[EREFS, HGO] from the
  "mode" property. The reference manual forbids changing these settings while
  the oscillator is running.

  Accepts one specifier. Setting it to 1 programs the oscillator settings
  into MCG_C2 and the load capacitors into OSC_CR. The oscillator can't be
  gated directly, so a value of 0 is rejected. The node reports its frequency
  only once the oscillator settings are programmed.

compatible: "nxp,kinetis-osc"

include: [clock-node.yaml]

properties:
  reg:
    required: true
    description: |
      Address and size of the OSC_CR register.

  frequency:
    type: int
    required: true
    description: |
      Frequency of the crystal or external clock connected to EXTAL, in Hz.

  mode:
    type: string
    required: true
    enum:
      - "external"
      - "low-power"
      - "high-gain"
    description: |
      Oscillator operating mode:
        - "external": an external clock drives EXTAL (MCG_C2[EREFS] = 0)
        - "low-power": crystal oscillator, low power mode (EREFS = 1, HGO = 0)
        - "high-gain": crystal oscillator, high gain mode (EREFS = 1, HGO = 1)

  load-capacitance-pf:
    type: int
    default: 0
    description: |
      Internal load capacitance to add to the oscillator, in picofarads.
      Must be an even value from 0 to 30, programmed via OSC_CR[SCxP].

  "#clock-cells":
    const: 1

clock-cells:
  - enable
```

## dts/bindings/clock-management/nxp-kinetis/nxp,kinetis-rtc-clkout.yaml
```yaml
# Copyright 2026 Analog Devices, Inc.
# SPDX-License-Identifier: Apache-2.0

description: |
  Kinetis RTC 32 kHz clock output gate, RTC_CR[CLKO]. This gate is active
  low: clearing the bit outputs the RTC oscillator clock to other peripherals.

  Accepts one specifier, which either gates the clock (when set to 0), or
  ungates the clock (when set to 1).

compatible: "nxp,kinetis-rtc-clkout"

include: [clock-node.yaml]

properties:
  input:
    type: phandle
    required: true
    description: |
      phandle to the RTC oscillator.

  reg:
    required: true
    description: |
      Address and size of the RTC_CR register.

  offset:
    type: int
    required: true
    description: |
      Offset of the active low gate bit within RTC_CR.

  "#clock-cells":
    const: 1

clock-cells:
  - gate
```

## dts/bindings/clock-management/nxp-kinetis/nxp,kinetis-rtc-osc.yaml
```yaml
# Copyright 2026 Analog Devices, Inc.
# SPDX-License-Identifier: Apache-2.0

description: |
  Kinetis 32.768 kHz RTC oscillator, enabled by RTC_CR[OSCE]. RTC registers
  are only accessible while SIM_SCGC6[RTC] is set, so the driver enables
  access around each RTC_CR access, then restores the previous gate state.

  The oscillator has no ready flag. See
  CONFIG_NXP_KINETIS_RTC_OSC_STARTUP_DELAY.

  Accepts one specifier, which disables the oscillator (when set to 0), or
  enables the oscillator (when set to 1).

compatible: "nxp,kinetis-rtc-osc"

include: [clock-node.yaml]

properties:
  reg:
    required: true
    description: |
      Address and size of the RTC_CR register.

  frequency:
    type: int
    required: true
    description: |
      Frequency of the RTC crystal, in Hz.

  load-capacitance-pf:
    type: int
    default: 0
    description: |
      Internal load capacitance to add to the oscillator, in picofarads.
      Must be an even value from 0 to 30, programmed via RTC_CR[SCxP].

  "#clock-cells":
    const: 1

clock-cells:
  - enable
```

## dts/bindings/clock-management/nxp-kinetis/nxp,kinetis-sim-frac-div.yaml
```yaml
# Copyright 2026 Analog Devices, Inc.
# SPDX-License-Identifier: Apache-2.0

description: |
  Kinetis SIM fractional clock divider, such as SIM_CLKDIV2[USBFRAC,
  USBDIV]. The fraction bit is bit 0 of the register, and the divider is
  bits 3:1. Output rate is input * multiplier / divider.

  Accepts two specifiers:
    - multiplier: 1 or 2 (FRAC + 1)
    - divider: 1 to 8 (DIV + 1)
  The multiplier may not exceed the divider, so the output rate never
  exceeds the input rate.

compatible: "nxp,kinetis-sim-frac-div"

include: [clock-node.yaml]

properties:
  reg:
    required: true
    description: |
      Address and size of the SIM clock divider register.

  input:
    type: phandle
    required: true
    description: |
      phandle to upstream clock that this divider divides.

  "#clock-cells":
    const: 2

clock-cells:
  - multiplier
  - divider
```

## dts/bindings/clock-management/st/st,stm32-clock-div.yaml
```yaml
# Copyright 2026 Analog Devices Inc.
# SPDX-License-Identifier: Apache-2.0

description: |
  STM32 clock divider/prescaler. Divides its input clock by a configurable
  factor determined by a register bitfield.

  Accepts one specifier which sets the integer division factor. Setting this
  value to 0 has undefined behavior. The supported range of values depends
  on the specific clock node's bitfield width and divider encoding type.

  The encoding of the divider field is controlled by the "div-type" property:
    - "pow2":   Power-of-2 bus prescaler encoding.
                Field values 0-7 map to /1; 8-15 map to /2../512.
    - "linear": Linear encoding where the field value is used directly as
                the division factor.
                A field value of 0 means no clock output.
    - "rtcpre": HSE-to-RTC prescaler. The field value is the division
                factor; values 0 and 1 mean no clock output.

compatible: "st,stm32-clock-div"

include: [clock-node.yaml]

properties:
  reg:
    required: true
    description: |
      Register address containing the divider bitfield.

  offset:
    type: int
    required: true
    description: |
      Bit offset of the divider field within the register.

  width:
    type: int
    required: true
    description: |
      Bit width of the divider field.

  div-type:
    type: string
    required: true
    enum:
      - "pow2"
      - "linear"
      - "rtcpre"
    description: |
      Encoding type for the divider bitfield.

  input:
    type: phandle
    required: true
    description: |
      Clock node that is the input to this divider.

  "#clock-cells":
    const: 1

clock-cells:
  - divider
```

## dts/bindings/clock-management/st/st,stm32-clock-source.yaml
```yaml
# Copyright 2026 Analog Devices Inc.
# SPDX-License-Identifier: Apache-2.0

description: |
  STM32 internal clock source (RC oscillator). Represents a fixed-frequency
  on-chip oscillator with an enable bit and a ready status bit in a single
  RCC register.

  Accepts one specifier which controls the enable state:
    0 = disable, nonzero = enable.

compatible: "st,stm32-clock-source"

include: [clock-node.yaml]

properties:
  reg:
    required: true
    description: |
      Register address containing the enable and ready bits.

  offset:
    type: int
    required: true
    description: |
      Bit offset of the oscillator enable bit (e.g. HSION) within the register.

  ready-offset:
    type: int
    required: true
    description: |
      Bit offset of the oscillator ready flag (e.g. HSIRDY) within the register.

  frequency:
    type: int
    required: true
    description: |
      Fixed output frequency of this oscillator, in Hz.

  "#clock-cells":
    const: 1

clock-cells:
  - gate
```

## dts/bindings/clock-management/st/st,stm32-osc.yaml
```yaml
# Copyright 2026 Analog Devices Inc.
# SPDX-License-Identifier: Apache-2.0

description: |
  STM32 external oscillator (crystal or bypass). Represents an external
  clock source with an enable bit and a ready status bit. The default
  frequency may be overridden by the board devicetree.

  Accepts two specifiers:
    [0] Enable state (0 = disable, nonzero = enable)
    [1] Bypass mode (0 = crystal, 1 = external clock bypass)

compatible: "st,stm32-osc"

include: [clock-node.yaml]

properties:
  reg:
    required: true
    description: |
      Register address containing the enable and ready bits.

  offset:
    type: int
    required: true
    description: |
      Bit offset of the oscillator enable bit (e.g. HSEON) within the register.

  ready-offset:
    type: int
    required: true
    description: |
      Bit offset of the oscillator ready flag (e.g. HSERDY) within the register.

  bypass-offset:
    type: int
    required: true
    description: |
      Bit offset of the oscillator bypass bit (e.g. HSEBYP) within the register.

  frequency:
    type: int
    required: true
    description: |
      Default output frequency of this oscillator, in Hz.
      Board-level devicetrees should override this to match the actual crystal.

  "#clock-cells":
    const: 2

clock-cells:
  - gate
  - bypass
```

## dts/bindings/clock-management/st/st,stm32-pll-postdiv.yaml
```yaml
# Copyright 2026 Analog Devices Inc.
# SPDX-License-Identifier: Apache-2.0

description: |
  STM32 PLL post-divider (P/Q/R output). Divides the PLL VCO output by a
  programmable factor and has its own output enable bit.

  Accepts two specifiers:
    [0] Division factor
    [1] Output enable (0 = disabled, 1 = enabled)

compatible: "st,stm32-pll-postdiv"

include: [clock-node.yaml]

properties:
  reg:
    required: true
    description: |
      Two register ranges:
        [0] PLLxDIVR register containing the divider field
        [1] RCC_PLLCFGR register containing the output enable bit

  offset:
    type: int
    required: true
    description: |
      Bit offset of the divider field within the PLLxDIVR register.

  width:
    type: int
    required: true
    description: |
      Bit width of the divider field.

  enable-offset:
    type: int
    required: true
    description: |
      Bit offset of the output enable bit within RCC_PLLCFGR.

  input:
    type: phandle
    required: true
    description: |
      Clock node for the parent clock.

  div-type:
    type: string
    required: true
    enum:
      - "linear"
      - "no-odd"
      - "l4"
      - "l4p"
    description: |
      When set, specifies the type of post-divider

  "#clock-cells":
    const: 1

clock-cells:
  - divider
  - enable
```

## dts/bindings/clock-management/st/st,stm32h7-pll.yaml
```yaml
# Copyright 2026 Analog Devices Inc.
# SPDX-License-Identifier: Apache-2.0

description: |
  STM32H7 PLL (fractional VCO). Describes one of the three PLLs (PLL1/2/3)
  on the STM32H7, each with a fractional-N VCO. The VCO output frequency is:

    f_VCO = f_ref * (DIVN + 1 + FRACN / 2^13)

  where f_ref is the input clock after the DIVMx prescaler.

  Accepts five specifiers that configure the VCO:
    [0] DIVN  - VCO multiplication factor (N)
    [1] FRACN - Fractional divider value (0-8191)
    [2] RGE   - Input frequency range selection
    [3] VCOSEL - VCO output range (0 = wide 192-836 MHz, 1 = medium 150-420 MHz)
    [4] Enable (0 = disable, nonzero = enable)

compatible: "st,stm32h7-pll"

include: [clock-node.yaml]

properties:
  reg:
    required: true
    description: |
      Two register ranges:
        [0] PLLxDIVR and PLLxFRACR registers (8 bytes)
        [1] RCC_CR register base (used for enable/ready bits and to derive
            the PLLCFGR address at offset +0x2C)

  enable-bit:
    type: int
    required: true
    description: |
      Bit offset of the PLL enable bit (e.g. PLL1ON) within the enable register.

  fracen-bit:
    type: int
    required: true
    description: |
      Bit offset of the PLL fractional latch enable bit (e.g. PLL1FRACEN)
      within the PLL configuration register.

  input:
    type: phandle
    required: true
    description: |
      Clock node for the PLL reference input (after the DIVMx prescaler).

  "#clock-cells":
    const: 5

clock-cells:
  - divn
  - fracn
  - rge
  - vcosel
  - enable
```
