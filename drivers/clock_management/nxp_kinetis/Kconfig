## drivers/clock_management/nxp_kinetis/Kconfig
```kconfig
# Copyright 2026 Analog Devices, Inc.
# SPDX-License-Identifier: Apache-2.0

config CLOCK_MANAGEMENT_NXP_KINETIS
	bool
	help
	  NXP Kinetis clock management drivers

config CLOCK_MANAGEMENT_NXP_KINETIS_OSC
	bool "NXP Kinetis system oscillator driver"
	default y
	depends on DT_HAS_NXP_KINETIS_OSC_ENABLED
	select CLOCK_MANAGEMENT_NXP_KINETIS
	help
	  NXP Kinetis system oscillator (OSC) driver. Programs the oscillator
	  range, gain and load capacitance from devicetree properties.

config CLOCK_MANAGEMENT_NXP_KINETIS_CLOCK_GATE
	bool "NXP Kinetis 8-bit clock gate driver"
	default y
	depends on DT_HAS_NXP_KINETIS_CLOCK_GATE_ENABLED
	select CLOCK_MANAGEMENT_NXP_KINETIS
	help
	  NXP Kinetis clock gate driver for gates within the 8-bit MCG and OSC
	  register blocks.

config CLOCK_MANAGEMENT_NXP_KINETIS_RTC_OSC
	bool "NXP Kinetis RTC oscillator driver"
	default y
	depends on DT_HAS_NXP_KINETIS_RTC_OSC_ENABLED
	select CLOCK_MANAGEMENT_NXP_KINETIS
	help
	  NXP Kinetis 32.768 kHz RTC oscillator driver

config CLOCK_MANAGEMENT_NXP_KINETIS_RTC_CLKOUT
	bool "NXP Kinetis RTC 32 kHz clock output driver"
	default y
	depends on DT_HAS_NXP_KINETIS_RTC_CLKOUT_ENABLED
	select CLOCK_MANAGEMENT_NXP_KINETIS
	help
	  NXP Kinetis driver for the RTC_CR[CLKO] gate, which controls whether
	  the RTC 32 kHz clock is output to other peripherals.

config CLOCK_MANAGEMENT_NXP_KINETIS_MCG_FCRDIV
	bool "NXP Kinetis MCG fast IRC divider driver"
	default y
	depends on DT_HAS_NXP_KINETIS_MCG_FCRDIV_ENABLED
	select CLOCK_MANAGEMENT_NXP_KINETIS
	help
	  NXP Kinetis MCG fast internal reference clock divider (FCRDIV) driver

config CLOCK_MANAGEMENT_NXP_KINETIS_MCG_MUX
	bool "NXP Kinetis MCG multiplexer driver"
	default y
	depends on DT_HAS_NXP_KINETIS_MCG_MUX_ENABLED
	select CLOCK_MANAGEMENT_NXP_KINETIS
	help
	  NXP Kinetis MCG multiplexer driver, for the IRCS, IREFS, PLLS and
	  OSCSEL selections

config CLOCK_MANAGEMENT_NXP_KINETIS_MCG_CLKS
	bool "NXP Kinetis MCG output clock select driver"
	default y
	depends on DT_HAS_NXP_KINETIS_MCG_CLKS_ENABLED
	select CLOCK_MANAGEMENT_NXP_KINETIS
	help
	  NXP Kinetis MCGOUTCLK source select (CLKS) and low power bypass (LP)
	  driver

config CLOCK_MANAGEMENT_NXP_KINETIS_MCG_FRDIV
	bool "NXP Kinetis MCG FLL reference divider driver"
	default y
	depends on DT_HAS_NXP_KINETIS_MCG_FRDIV_ENABLED
	select CLOCK_MANAGEMENT_NXP_KINETIS
	help
	  NXP Kinetis MCG FLL external reference divider (FRDIV) driver

config CLOCK_MANAGEMENT_NXP_KINETIS_MCG_FLL
	bool "NXP Kinetis MCG FLL driver"
	default y
	depends on DT_HAS_NXP_KINETIS_MCG_FLL_ENABLED
	select CLOCK_MANAGEMENT_NXP_KINETIS
	help
	  NXP Kinetis MCG frequency locked loop (FLL) driver

config CLOCK_MANAGEMENT_NXP_KINETIS_MCG_PLL
	bool "NXP Kinetis MCG PLL driver"
	default y
	depends on DT_HAS_NXP_KINETIS_MCG_PLL_ENABLED
	select CLOCK_MANAGEMENT_NXP_KINETIS
	help
	  NXP Kinetis MCG phase locked loop (PLL) driver

config CLOCK_MANAGEMENT_NXP_KINETIS_MCG
	bool "NXP Kinetis MCG driver"
	default y
	depends on DT_HAS_NXP_KINETIS_MCG_CLK_ENABLED
	select CLOCK_MANAGEMENT_NXP_KINETIS
	help
	  NXP Kinetis MCG driver, which provides access to the MCG registers and
	  overall MCG configuration.

config CLOCK_MANAGEMENT_NXP_KINETIS_SIM_FRAC_DIV
	bool "NXP Kinetis SIM fractional divider driver"
	default y
	depends on DT_HAS_NXP_KINETIS_SIM_FRAC_DIV_ENABLED
	select CLOCK_MANAGEMENT_NXP_KINETIS
	help
	  NXP Kinetis SIM fractional clock divider driver, such as the USB
	  clock divider in SIM_CLKDIV2

if CLOCK_MANAGEMENT_NXP_KINETIS

config NXP_KINETIS_CLOCK_TIMEOUT
	int "NXP Kinetis clock status timeout (in microseconds)"
	default 1000000
	help
	  Timeout value for waiting on MCG status bits (CLKST, IREFST, PLLST,
	  IRCST, LOCK0 and OSCINIT0) to reflect a new configuration. The
	  longest expected wait is crystal oscillator startup, which can take
	  up to one second for a 32 kHz crystal.

endif # CLOCK_MANAGEMENT_NXP_KINETIS

config NXP_KINETIS_FLL_ACQUIRE_DELAY
	int "NXP Kinetis FLL acquisition delay (in microseconds)"
	default 1000
	depends on CLOCK_MANAGEMENT_NXP_KINETIS_MCG_FLL || CLOCK_MANAGEMENT_NXP_KINETIS_MCG_MUX || \
			CLOCK_MANAGEMENT_NXP_KINETIS_MCG_CLKS
	help
	  Time to wait for the FLL to lock after its reference or
	  multiplication factor changes. The FLL has no lock status bit, so
	  this should match the tfll_acquire value from the device datasheet.

config NXP_KINETIS_RTC_OSC_STARTUP_DELAY
	int "NXP Kinetis RTC oscillator startup delay (in microseconds)"
	default 0
	depends on CLOCK_MANAGEMENT_NXP_KINETIS_RTC_OSC
	help
	  Time to wait after enabling the RTC oscillator before it is treated
	  as stable. The RTC oscillator has no ready status bit. Boards that
	  use the RTC oscillator as an MCG reference should set this to the
	  crystal startup time from the device datasheet.
```

## drivers/clock_management/st/Kconfig
```kconfig
# Copyright 2026 Analog Devices Inc.
# SPDX-License-Identifier: Apache-2.0

config CLOCK_MANAGEMENT_STM32
	bool
	help
	  STM32 clock management drivers

config CLOCK_MANAGEMENT_STM32_CLOCK_SOURCE
	bool "STM32 clock source driver"
	default y
	depends on DT_HAS_ST_STM32_CLOCK_SOURCE_ENABLED
	select CLOCK_MANAGEMENT_STM32
	help
	  STM32 clock source driver for fixed-frequency oscillators
	  that can be gated/ungated

config CLOCK_MANAGEMENT_STM32_OSC
	bool "STM32 oscillator driver"
	default y
	depends on DT_HAS_ST_STM32_OSC_ENABLED
	select CLOCK_MANAGEMENT_STM32
	help
	  STM32 oscillator driver for external oscillators with bypass support

config CLOCK_MANAGEMENT_STM32_PLL_POSTDIV
	bool "STM32 PLL post-divider driver"
	default y
	depends on DT_HAS_ST_STM32_PLL_POSTDIV_ENABLED
	select CLOCK_MANAGEMENT_STM32
	help
	  STM32 PLL output post-divider driver (P/Q/R outputs)

config CLOCK_MANAGEMENT_STM32_CLOCK_DIV
	bool "STM32 clock divider driver"
	default y
	depends on DT_HAS_ST_STM32_CLOCK_DIV_ENABLED
	select CLOCK_MANAGEMENT_STM32
	help
	  STM32 clock divider driver supporting power-of-2, linear,
	  and RTCPRE divider encodings

config CLOCK_MANAGEMENT_STM32H7_PLL
	bool "STM32H7 PLL driver"
	default y
	depends on DT_HAS_ST_STM32H7_PLL_ENABLED
	select CLOCK_MANAGEMENT_STM32
	help
	  STM32H7 fractional-N PLL driver for the three PLLs
	  (PLL1/2/3) on the STM32H7 series

if CLOCK_MANAGEMENT_STM32_CLOCK_SOURCE || CLOCK_MANAGEMENT_STM32_OSC

config STM32_CLOCK_READY_TIMEOUT
	int "STM32 clock ready timeout (in microseconds)"
	default 1000
	help
	  Timeout value for waiting for STM32 clock gates to become enabled or
	  disabled after modifying their state

endif # CLOCK_MANAGEMENT_STM32_CLOCK_SOURCE || CLOCK_MANAGEMENT_STM32_OSC

config STM32H7_PLL_LOCK_TIMEOUT
	int "STM32H7 PLL lock timeout (in microseconds)"
	default 2000
	depends on CLOCK_MANAGEMENT_STM32H7_PLL
	help
	  Timeout value for waiting for the STM32H7 PLLs to lock after being enabled
```

## dts/bindings/clock-management/clock-div.yaml
```yaml
# Copyright 2026 Analog Devices, Inc.
# SPDX-License-Identifier: Apache-2.0

description: |
  Generic clock divider node. Divides its input clock by a factor programmed
  into a register bitfield.

  Accepts one specifier, which sets the integer division factor. A division
  factor that cannot be encoded by the divider's bitfield is rejected.

  The encoding of the divider bitfield is selected by the "div-type" property:
    - "linear": The division factor is the field value plus one, so a field
                of width N supports division factors 1 to 2^N.
    - "pow2":   The division factor is two raised to the field value, so a
                field of width N supports division factors 1 to 2^(2^N - 1).

compatible: "clock-div"

include: [clock-node.yaml]

properties:
  reg:
    required: true
    description: |
      Tuple containing address of register and width of the bitfield
      used to set the division factor.

  offset:
    type: int
    required: true
    description: |
      Offset of bitfield within register used to set the division factor.

  div-type:
    type: string
    required: true
    enum:
      - "linear"
      - "pow2"
    description: |
      Encoding type for the divider bitfield.

  reg-io-width:
    type: int
    default: 4
    enum:
      - 1
      - 2
      - 4
    description: |
      Width in bytes of the register access used to read and write the
      divider. Some peripherals (for example 8-bit register blocks) generate a
      bus error if accessed with a wider access than the register width.

  input:
    type: phandle
    required: true
    description: |
      phandle to upstream clock that this divider divides.

  "#clock-cells":
    const: 1

clock-cells:
  - divider
```

## dts/bindings/clock-management/nxp-kinetis/nxp,kinetis-clock-gate.yaml
```yaml
# Copyright 2026 Analog Devices, Inc.
# SPDX-License-Identifier: Apache-2.0

description: |
  Kinetis clock gate within an 8-bit register block, such as MCG_C1[IRCLKEN]
  or OSC_CR[ERCLKEN]. These registers generate a bus error on wider
  accesses, so the generic clock-gate can't be used for them.

  Accepts one specifier, which either gates the clock (when set to 0), or
  ungates the clock (when set to 1).

compatible: "nxp,kinetis-clock-gate"

include: [clock-node.yaml]

properties:
  input:
    type: phandle
    required: true
    description: |
      phandle to upstream clock that this gate controls.

  reg:
    required: true
    description: |
      Tuple containing address of the 8-bit register and width of the
      bitfield to set to ungate the clock.

  offset:
    type: int
    required: true
    description: |
      Offset of bitfield within register to set to ungate clock.

  wait-osc-init:
    type: boolean
    description: |
      After ungating, wait for MCG_S[OSCINIT0] when the system oscillator is
      in crystal mode. Set for gates that start the system oscillator.

  "#clock-cells":
    const: 1

clock-cells:
  - gate
```

## dts/bindings/clock-management/nxp-kinetis/nxp,kinetis-mcg-clk.yaml
```yaml
# Copyright 2026 Analog Devices, Inc.
# SPDX-License-Identifier: Apache-2.0

description: |
  Kinetis MCG clock node. Used for configuring the MCG clock subsystem state
  selection. The node accepts the following specifiers:
  - mode: Specifies the desired MCG mode for the clock.

compatible: "nxp,kinetis-mcg-clk"

include: [clock-node.yaml]

properties:
  reg:
    required: true
    description: |
      Address and size of the MCG base register.

  sirc:
    required: true
    type: phandle
    description: |
      Phandle to the slow IRC clock node.

  frdiv:
    required: true
    type: phandle
    description: |
      Phandle to the FLL external reference divider clock node.

  oscsel:
    required: true
    type: phandle
    description: |
      Phandle to the MCG external reference select clock node.

  ircs:
    required: true
    type: phandle
    description: |
      Phandle to the IRC select clock node.

  pll:
    required: true
    type: phandle
    description: |
      Phandle to the PLL clock node.

  "#clock-cells":
    const: 1

child-binding:
  properties:
    clk-type:
      required: true
      type: string
      enum:
        - out
        - ff
      description: |
        Type of the MCG clock (out or ff).

clock-cells:
  - mode
```

## dts/bindings/clock-management/nxp-kinetis/nxp,kinetis-mcg-clks.yaml
```yaml
# Copyright 2026 Analog Devices, Inc.
# SPDX-License-Identifier: Apache-2.0

description: |
  Kinetis MCG output clock (MCGOUTCLK) source select, MCG_C1[CLKS], combined
  with the low power bypass bit MCG_C2[LP].

  Accepts two specifiers:
    - clks: MCGOUTCLK source. 0 selects the FLL or PLL output (as selected by
      C6[PLLS]), 1 the internal reference clock, and 2 the external
      reference clock. These index the "input-sources" property.
    - lp: Set to 1 to enter a bypassed low power mode (BLPI or BLPE), which
      disables the FLL and PLL. Only valid when clks is 1 or 2.

  The MCG only permits certain mode transitions (see the MCG mode state
  diagram in the reference manual). Clock states must step through legal
  modes in order, for example FEI -> FBE -> PBE -> PEE. The driver waits for
  S[CLKST] after each change, for S[LOCK0] before selecting a PLL output,
  and for S[OSCINIT0] when selecting a crystal external reference.

compatible: "nxp,kinetis-mcg-clks"

include: [clock-node.yaml]

properties:
  reg:
    required: true
    description: |
      Address and size of the MCG_C1 register.

  input-sources:
    type: phandles
    required: true
    description: |
      FLL/PLL select (PLLS), internal reference select (IRCS), and external
      reference select (OSCSEL) clock nodes, in that order.

  "#clock-cells":
    const: 2

clock-cells:
  - clks
  - lp
```

## dts/bindings/clock-management/nxp-kinetis/nxp,kinetis-mcg-fcrdiv.yaml
```yaml
# Copyright 2026 Analog Devices, Inc.
# SPDX-License-Identifier: Apache-2.0

description: |
  Kinetis MCG fast internal reference clock divider, MCG_SC[FCRDIV].

  Accepts one specifier, which sets the division factor. Valid values are
  powers of two from 1 to 128. The divider can't change while the fast IRC is
  enabled (selected by C2[IRCS] and used for MCGIRCLK or MCGOUTCLK), so such
  changes are rejected. The write-1-to-clear flags in MCG_SC (LOCS0 and ATMF)
  are preserved when the divider is written.

compatible: "nxp,kinetis-mcg-fcrdiv"

include: [clock-node.yaml]

properties:
  reg:
    required: true
    description: |
      Address and size of the MCG_SC register.

  input:
    type: phandle
    required: true
    description: |
      phandle to the fast internal reference clock.

  "#clock-cells":
    const: 1

clock-cells:
  - divider
```

## dts/bindings/clock-management/nxp-kinetis/nxp,kinetis-mcg-fll.yaml
```yaml
# Copyright 2026 Analog Devices, Inc.
# SPDX-License-Identifier: Apache-2.0

description: |
  Kinetis MCG frequency locked loop (FLL), configured by MCG_C4[DRST_DRS,
  DMX32].

  Accepts one specifier, which sets the FLL multiplication factor. Valid
  factors are 640, 1280, 1920 and 2560 (DMX32 = 0), or 732, 1464, 2197 and
  2929 (DMX32 = 1, intended for a 32.768 kHz reference). The factor can't
  change while MCG_C2[LP] is set.

  The FLL is disabled while C6[PLLS] selects the PLL, or in BLPI/BLPE mode,
  and reports a rate of 0 then. Because these settings belong to other
  nodes, a cached FLL rate is not refreshed when they change.

compatible: "nxp,kinetis-mcg-fll"

include: [clock-node.yaml]

properties:
  reg:
    required: true
    description: |
      Address and size of the MCG_C4 register.

  input:
    type: phandle
    required: true
    description: |
      phandle to the FLL reference select (IREFS).

  "#clock-cells":
    const: 1

clock-cells:
  - multiplier
```

## dts/bindings/clock-management/nxp-kinetis/nxp,kinetis-mcg-frdiv.yaml
```yaml
# Copyright 2026 Analog Devices, Inc.
# SPDX-License-Identifier: Apache-2.0

description: |
  Kinetis MCG FLL external reference divider, MCG_C1[FRDIV].

  Accepts one specifier, which sets the division factor. The available
  factors depend on the external reference: when MCG_C2[RANGE] is 0 or the
  RTC oscillator is selected (C7[OSCSEL] = 1), the factor may be 1, 2, 4, 8,
  16, 32, 64 or 128. Otherwise, it may be 32, 64, 128, 256, 512, 1024, 1280
  or 1536. The divided reference must be within 31.25-39.0625 kHz when the
  FLL is engaged.

  The divider reads C2[RANGE] and C7[OSCSEL] directly. Rate change
  notifications sent while OSCSEL is changing are therefore calculated with
  the previous OSCSEL encoding.

compatible: "nxp,kinetis-mcg-frdiv"

include: [clock-node.yaml]

properties:
  reg:
    required: true
    description: |
      Address and size of the MCG_C1 register.

  input:
    type: phandle
    required: true
    description: |
      phandle to the MCG external reference select.

  "#clock-cells":
    const: 1

clock-cells:
  - divider
```
